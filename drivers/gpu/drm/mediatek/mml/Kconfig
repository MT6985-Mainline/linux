## drivers/gpu/drm/mediatek/mml/Kconfig
```kconfig
# SPDX-License-Identifier: GPL-2.0-only

config MTK_MML
	tristate "DRM MML Support for Mediatek SoCs"
	help
	  Choose this option if you have a Mediatek SoCs.
	  The module will be called mml in mediatek-drm
	  This driver provides kernel mode setting and
	  buffer management to display driver.

config MTK_MML_DEBUG
	bool "DRM MML Debug Support for Mediatek SoCs"
	help
	  Choose this option if you have a Mediatek SoCs.
	  This driver provides mml driver unit test nodes
	  and mml driver debug feature. Trigger by mml
	  UnitTest binary.

config MTK_MML_LEGACY
	tristate "DRM MML Legacy Support for Mediatek SoCs"
	help
	  Choose this option if you have a Mediatek SoCs.
	  The module will be called mml in mediatek-drm
	  This driver provides kernel mode setting and
	  buffer management to display driver.


config MTK_MML_MT6985
	tristate "MediaTek MT6985 MML topology"
	depends on MTK_MML
	default MTK_MML if COMMON_CLK_MT6985
	help
	  Build the complete MT6985 MML path, client and mode-selection tables.
	  This is required by the corot display pipeline.

config MTK_MML_MT6886
	tristate "MediaTek MT6886 MML topology"
	depends on MTK_MML
	help
	  Build the MT6886-specific MML path tables.

config MTK_MML_MT6983
	tristate "MediaTek MT6983 MML topology"
	depends on MTK_MML
	help
	  Build the legacy MT6983-specific MML path tables.
```

## drivers/interconnect/mediatek/Kconfig
```kconfig
# SPDX-License-Identifier: GPL-2.0-only

config INTERCONNECT_MTK
	bool "MediaTek interconnect drivers"
	depends on ARCH_MEDIATEK || COMPILE_TEST
	help
	  Support for MediaTek's bus interconnect hardware.

config INTERCONNECT_MTK_DVFSRC_EMI
	tristate "MediaTek DVFSRC EMI interconnect driver"
	depends on INTERCONNECT_MTK && MTK_DVFSRC
	help
	  This is a driver for the MediaTek External Memory Interface
	  interconnect on SoCs equipped with the integrated Dynamic
	  Voltage Frequency Scaling Resource Collector (DVFSRC) MCU

config INTERCONNECT_MTK_MT8183
	tristate "MediaTek MT8183 interconnect driver"
	depends on INTERCONNECT_MTK_DVFSRC_EMI
	help
	  This is a driver for the MediaTek bus interconnect on MT8183-based
	  platforms.

config INTERCONNECT_MTK_MT8195
	tristate "MediaTek MT8195 interconnect driver"
	depends on INTERCONNECT_MTK_DVFSRC_EMI
	help
	  This is a driver for the MediaTek bus interconnect on MT8195-based
	  platforms.

config INTERCONNECT_MTK_MT8196
	tristate "MediaTek MT8196 interconnect driver"
	depends on INTERCONNECT_MTK_DVFSRC_EMI
	help
	  This is a driver for the MediaTek bus interconnect on MT8196-based
	  platforms.

config INTERCONNECT_MTK_EMI
	tristate "MediaTek MT6985 EMI interconnect"
	depends on INTERCONNECT_MTK && MTK_DVFSRC && OF
	help
	  Expose the genuine downstream EMI bandwidth and HRT votes to DVFSRC.

source "drivers/misc/mediatek/mtk-interconnect/Kconfig"

config INTERCONNECT_MTK_MMQOS_COMMON
	tristate
	depends on INTERCONNECT_MTK && MTK_MMDVFS && MTK_DRAMC
	select INTERCONNECT_MTK_EXTENSION

config INTERCONNECT_MTK_MMQOS_MT6985
	tristate "MediaTek MT6985 multimedia QoS"
	depends on INTERCONNECT_MTK && MTK_SMI && MTK_MMDVFS && MTK_DRAMC
	depends on INTERCONNECT_MTK_EMI
	select INTERCONNECT_MTK_MMQOS_COMMON
	help
	  Use the MT6985 SMI topology, port bandwidth and outstanding limits,
	  and HRT accounting for display, MML and other multimedia engines.
```

## drivers/misc/mediatek/Kconfig
```kconfig
# SPDX-License-Identifier: GPL-2.0
source "drivers/misc/mediatek/cmdq/Kconfig"
source "drivers/misc/mediatek/mminfra/Kconfig"
source "drivers/misc/mediatek/btif/Kconfig"
source "drivers/misc/mediatek/connectivity/Kconfig"
source "drivers/misc/mediatek/geniezone/Kconfig"
source "drivers/misc/mediatek/trusted_mem/Kconfig"
source "drivers/misc/mediatek/scp/Kconfig"
```

## drivers/misc/mediatek/cmdq/Kconfig
```kconfig
# SPDX-License-Identifier: GPL-2.0
config MTK_CMDQ_MBOX_EXT
	tristate "enable CMDQ mailbox driver extension"
	help
	  This extension enable debug feature, such as cmdq-status,
	  cmdq-record, pre-dump, timeout error dump, first error buffer
	  and aee db. Enable performance tools which add instruction
	  inside packet and profiling. Also enable secure path with
	  new sec controller which decuple with v3 driver.

config MTK_CMDQ_SECURE
	bool "MediaTek secure CMDQ mailbox"
	depends on MTK_CMDQ_MBOX_EXT=y && MTK_GZ_TZ_SYSTEM=y
	help
	  Build the secure CMDQ mailbox and packet metadata helpers using the
	  original MediaTek MTEE/KREE secure task submission, cancellation and
	  shared execution-cookie protocol.
```

## drivers/misc/mediatek/scp/Kconfig
```kconfig
# SPDX-License-Identifier: GPL-2.0
config MTK_TINYSYS_SCP_SUPPORT
	bool "MediaTek bootloader-loaded RV SCP interface"
	depends on ARM64 && OF && OF_RESERVED_MEM && COMMON_CLK
	depends on MTK_MBOX = y && MTK_IPI = y
	select MFD_SYSCON
	help
	  Provide the reserved-memory and mailbox/IPI interface used by
	  MediaTek RV SCP firmware loaded by the platform bootloader.
	  This supports the vendor mediatek,scp binding used on MT6985,
	  including AOD shared memory and the actual SCP awake protocol.
	  The upstream MTK_SCP remoteproc driver uses a different binding.
```
